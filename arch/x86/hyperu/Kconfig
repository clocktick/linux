## arch/x86/hyperu/Kconfig
```kconfig
# SPDX-License-Identifier: GPL-2.0
#

config HYPERU
	bool "A userspace kernel based on PVOPS framework"
	depends on X86_64 && PARAVIRT
	depends on !X86_5LEVEL
	depends on !EFI
	depends on !RANDOMIZE_BASE
	depends on !XEN
	depends on !KCOV
```

## arch/x86/pvuser/Kconfig
```kconfig
# SPDX-License-Identifier: GPL-2.0
#
# This Kconfig describes pvuser options
#

config PARAVIRT_USER
	bool "PV-userspace kernel"
	depends on X86_64 && PARAVIRT
	depends on !X86_5LEVEL
	depends on !EFI
	depends on !RANDOMIZE_BASE
	depends on !XEN
```
